    CHIP	N589
	SYMBOLS
	LINKLIST
	DEBUG  	ASM
	LINEAR	ON
	LONGA	OFF
	LONGI	OFF

	INCLUDE	SYS_DEF_EQU.INI
	PUBLIC ADD_CHECKSUM_HANDLE
	PUBLIC	NAPP_PLAYLIST_TABLE_ADDR1
	PUBLIC	NAPP_PLAYLIST_TABLE_ADDR2
	PUBLIC	NAPP_PLAYLIST_TABLE_ADDR3

.IFDEF DATA_FLASH_SIZE_512
BODY_BEGIN_SEC0_ADDR	EQU 1080H
BODY_END_SEC0_ADDR		EQU 11FFH
BODY_BEGIN_ADDR			EQU 1400H
.ENDIF
.IFDEF DATA_FLASH_SIZE_1024
BODY_BEGIN_SEC0_ADDR	EQU 1080H
BODY_END_SEC0_ADDR		EQU 11FFH
BODY_BEGIN_ADDR			EQU 1600H
.ENDIF
.IFNDEF BODY_BEGIN_ADDR
BODY_BEGIN_ADDR		EQU 00001080H
.ENDIF

.IF	 (PARTNO='N589B080').OR.(PARTNO='N589C080').OR.(PARTNO='N589D080').OR.(PARTNO='N589D081')
BODY_END_ADDR		EQU 0001FFFFH+1000H
.ENDIF

.IF	 (PARTNO='N589B120').OR.(PARTNO='N589C120').OR.(PARTNO='N589D120').OR.(PARTNO='N589D121')
BODY_END_ADDR		EQU 00027FFFH+1000H
.ENDIF

.IF	 (PARTNO='N589A080').OR.(PARTNO='N589B170').OR.(PARTNO='N589C170').OR.(PARTNO='N589D170').OR.(PARTNO='N589D171')
BODY_END_ADDR		EQU 0002FFFFH+1000H
.ENDIF

.IF	 (PARTNO='N589A150').OR.(PARTNO='N589B200').OR.(PARTNO='N589C200').OR.(PARTNO='N589D200').OR.(PARTNO='N589D201')
BODY_END_ADDR		EQU 0003FFFFH+1000H
.ENDIF

.IF	 (PARTNO='N589A200').OR.(PARTNO='N589B250').OR.(PARTNO='N589C250').OR.(PARTNO='N589D250').OR.(PARTNO='N589D251')
BODY_END_ADDR		EQU 0004FFFFH+1000H
.ENDIF

.IF	 (PARTNO='N589A280').OR.(PARTNO='N589B340').OR.(PARTNO='N589C340').OR.(PARTNO='N589D340').OR.(PARTNO='N589D341')
BODY_END_ADDR		EQU 0005FFFFH+1000H
.ENDIF

.IF	 (PARTNO='N589A400').OR.(PARTNO='N589B480').OR.(PARTNO='N589B480N').OR.(PARTNO='N589C480').OR.(PARTNO='N589D481')
BODY_END_ADDR		EQU 0007FFFFH+1000H
.ENDIF

.IF	 (PARTNO='N589A600').OR.(PARTNO='N589B650').OR.(PARTNO='N589C650').OR.(PARTNO='N589D650').OR.(PARTNO='N589D650N')
BODY_END_ADDR		EQU 000BFFFFH+1000H
.ENDIF

.IF	 (PARTNO='N589A900').OR.(PARTNO='N589B960').OR.(PARTNO='N589C960').OR.(PARTNO='N589D960').OR.(PARTNO='N589D960N')
BODY_END_ADDR		EQU 000FFFFFH+1000H
.ENDIF

NAPP_PLAYLIST_TABLE_ADDR1	EQU (BODY_END_ADDR & FFFFFFFCH)-40
NAPP_PLAYLIST_TABLE_ADDR2	EQU (BODY_END_ADDR & FFFFFFFCH)-36
NAPP_PLAYLIST_TABLE_ADDR3	EQU (BODY_END_ADDR & FFFFFFFCH)-32

    LIBRARY_CODE_NOCROSSING: SECTION
;===============================================================
;  			
;===============================================================
CALC_CHECKSUM MACRO START_ADDR, END_ADDR
	LDA #.LOW.START_ADDR
	STA !ISPADR0
	LDA #.HIGH.START_ADDR
	STA !ISPADR1
	LDA #.HIGH8.START_ADDR
	STA !ISPADR2
	
	;
	; process ROM_START - 60FFFH DATA
	;
	LDA #A6H
	STA !ISPULK
	LDA #E9H
	STA !ISPULK
	LDA #77H
	STA !ISPULK
	
	LDA	#ISP_EN
	TSB !ISPCON
	LDA #ISP_CMD_READ
	STA !ISPCMD
	
CHECKSUM_LOOP_LIB#:
	.IFDEF WDTIMER
	LDA #WDTC_CLR
	STA !WDTC
	.ENDIF 

	LDA #ISP_DONE
	TSB !ISPTRG
POLLING_ISP_TRG_LIB#:
	LDA !ISPTRG
	AND #ISP_DONE
	BNE POLLING_ISP_TRG_LIB#
	;
	; accumulate the results of ISPDAT0~3
	;
	LDX	#0
CHECKSUM_ACC_LIB#:
	CLC
	LDA	!ISPDAT0, X
	ADC	<CHECK_RESULT
	STA	<CHECK_RESULT
	LDA	<CHECK_RESULT+1
	ADC	#00H
	STA	<CHECK_RESULT+1
	
	INX
	CPX	#4
	BNE CHECKSUM_ACC_LIB#
	
ROM_ADDR_INC_LIB#:
	CLC
	LDA	!ISPADR0
	ADC #4
	STA !ISPADR0
	BNE	ROM_ADDR_CHECK_LIB#
	INC	!ISPADR1
	BNE	ROM_ADDR_CHECK_LIB#
	INC !ISPADR2
	BRA ROM_ADDR_CHECK_LIB#
	
ROM_ADDR_CHECK_LIB#:
	;
	; check if it is the last address
	;
	LDA !ISPADR2
	CMP #.HIGH8.(END_ADDR+1)
	BNE CHECKSUM_LOOP_LIB#
	LDA !ISPADR1
	CMP #.HIGH.(END_ADDR+1)
	BNE CHECKSUM_LOOP_LIB#
	LDA !ISPADR0
	CMP #.LOW.(END_ADDR+1)
	BEQ END_CHECKSUM_LIB#	
	JMP CHECKSUM_LOOP_LIB#

END_CHECKSUM_LIB#:	
	.IFDEF WDTIMER
	LDA #WDTC_CLR
	STA !WDTC
	.ENDIF
	
	LDA	#ISP_EN
	TRB !ISPCON
	STZ !ISPULK
	ENDM
;===============================================
ADD_CHECKSUM_HANDLE:
	
	STZ <CHECK_RESULT
	STZ <CHECK_RESULT+1
	
.IFDEF DATA_FLASH_SIZE_512
	CALC_CHECKSUM BODY_BEGIN_SEC0_ADDR, BODY_END_SEC0_ADDR
.ENDIF
.IFDEF DATA_FLASH_SIZE_1024
	CALC_CHECKSUM BODY_BEGIN_SEC0_ADDR, BODY_END_SEC0_ADDR
.ENDIF
	CALC_CHECKSUM BODY_BEGIN_ADDR, BODY_END_ADDR

	RTS
;===============================================


	ENDS
